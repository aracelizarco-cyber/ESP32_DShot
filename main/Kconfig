## main/Kconfig
```kconfig
menu "Greenhouse ESP DShot ESC Controller"

    menu "Network Configuration"
        
        config WIFI_SSID
            string "Wi‑Fi SSID"
            default ""
            help
              SSID for Wi‑Fi station mode. Leave empty to use NVS provisioning.
              For security, consider using esp_wifi_set_config() with NVS storage
              instead of hardcoding credentials.

        config WIFI_PASS
            string "Wi‑Fi Password"
            default ""
            help
              Password for Wi‑Fi station mode. Leave empty to use NVS provisioning.
              For security, consider using esp_wifi_set_config() with NVS storage
              instead of hardcoding credentials.

        config MQTT_BROKER_URI
            string "MQTT broker URI"
            default "mqtt://10.10.10.1"
            help
              Broker URI like mqtt://host:1883 or mqtts://host:8883.
              Default points to a common greenhouse network gateway.

        config MQTT_USERNAME
            string "MQTT username"
            default ""
            help
              Username for MQTT authentication. Leave empty if no auth required.

        config MQTT_PASSWORD
            string "MQTT password"
            default ""
            help
              Password for MQTT authentication. Leave empty if no auth required.
              For security, consider using NVS storage instead of hardcoding.

    endmenu

    menu "Fan Configuration"

        config FAN_COUNT
            int "Number of fans (ESCs) to control"
            range 1 8
            default 2
            help
              Set how many fans (ESCs) this device will control. Each fan uses one DShot GPIO.

        config FAN_INDEX_START
            int "First fan index (for multi-node setups)"
            range 1 8
            default 1
            help
              The index of the first fan this node controls (e.g., 1 for fans 1-2, 3 for fans 3-4).
              This allows multiple ESP32 nodes to control different fan ranges.

        config DSHOT_GPIOS
            string "DShot GPIOs (comma-separated, one per fan)"
            default "5,7"
            help
              Comma-separated list of GPIOs for DShot output, one per fan (e.g., "5,7" for two fans).
              Ensure GPIOs are available and not used by other peripherals.

        config MIN_SPIN_PCT
            int "Minimum spin percentage (to prevent stalls)"
            range 0 50
            default 15
            help
              Minimum percentage to apply when fan is ON (prevents stalling at low throttle).
              Set to 0 to allow fans to be completely stopped.

        config RAMP_STEP_PCT
            int "Ramp step percentage (smooth ramping)"
            range 1 20
            default 3
            help
              Step size for ramping fan speed up/down. Smaller values give smoother transitions
              but slower response. Larger values give faster response but less smooth operation.

        config RAMP_TICK_MS
            int "Ramp tick interval (ms)"
            range 5 200
            default 20
            help
              Interval in milliseconds between ramp steps. Shorter intervals give smoother
              ramping but use more CPU. Longer intervals are more efficient but less smooth.

    endmenu

    menu "DShot Protocol Configuration"

        choice DSHOT_SPEED
            prompt "DShot protocol speed"
            default DSHOT_SPEED_600
            help
              Select the DShot protocol speed. Higher speeds provide better resolution
              but require more precise timing and may not work with all ESCs.

            config DSHOT_SPEED_150
                bool "DShot150 (150 kbit/s)"
            config DSHOT_SPEED_300
                bool "DShot300 (300 kbit/s)"
            config DSHOT_SPEED_600
                bool "DShot600 (600 kbit/s)"
            config DSHOT_SPEED_1200
                bool "DShot1200 (1200 kbit/s)"
        endchoice

        config DSHOT_SPEED_VALUE
            int
            default 150 if DSHOT_SPEED_150
            default 300 if DSHOT_SPEED_300
            default 600 if DSHOT_SPEED_600
            default 1200 if DSHOT_SPEED_1200

        config TLM_ENABLE
            bool "Enable DShot telemetry"
            default n
            help
              Enable DShot telemetry to receive RPM and other data from ESCs.
              Note: Telemetry is currently not fully implemented in this version.

    endmenu

    menu "Safety and Failsafe"

        config FAILSAFE_MS
            int "Failsafe timeout (ms)"
            range 100 5000
            default 1500
            help
              Time in milliseconds after which fans will be stopped if no valid
              control commands are received. This is a safety feature to prevent
              runaway fans in case of communication failure.

        config REQUIRE_ARM
            bool "Require arming before fan operation"
            default y
            help
              When enabled, fans will not operate until the system is explicitly armed
              via MQTT command. This provides an additional safety layer for greenhouse
              operations where fans control critical environmental conditions.

        config ARM_TIMEOUT_S
            int "Auto-disarm timeout (seconds)"
            depends on REQUIRE_ARM
            range 60 3600
            default 300
            help
              Time in seconds after which the system will automatically disarm if no
              activity is detected. Set to 0 to disable auto-disarm.

    endmenu

endmenu
```

## sdkconfig.defaults
```kconfig
# ESP32 DShot Greenhouse Controller - Safe Default Configuration
# This file contains safe, non-secret defaults for the greenhouse ESP controller.
# Secrets and site-specific settings should be configured via menuconfig or NVS.

# Network Configuration - Leave credentials empty for security
CONFIG_WIFI_SSID=""
CONFIG_WIFI_PASS=""
CONFIG_MQTT_BROKER_URI="mqtt://10.10.10.1"
CONFIG_MQTT_USERNAME=""
CONFIG_MQTT_PASSWORD=""

# Fan Configuration
CONFIG_FAN_COUNT=2
CONFIG_FAN_INDEX_START=1
CONFIG_DSHOT_GPIOS="5,7"
CONFIG_MIN_SPIN_PCT=15
CONFIG_RAMP_STEP_PCT=3
CONFIG_RAMP_TICK_MS=20

# DShot Protocol Configuration
CONFIG_DSHOT_SPEED_600=y
CONFIG_DSHOT_SPEED_VALUE=600
CONFIG_TLM_ENABLE=n

# Safety and Failsafe
CONFIG_FAILSAFE_MS=1500
CONFIG_REQUIRE_ARM=y
CONFIG_ARM_TIMEOUT_S=300

# ESP-IDF Component Configuration
CONFIG_FREERTOS_HZ=1000
CONFIG_ESP_TASK_WDT_EN=y
CONFIG_ESP_TASK_WDT_TIMEOUT_S=5
CONFIG_ESP_MAIN_TASK_STACK_SIZE=4096

# Wi-Fi Configuration for better greenhouse reliability
CONFIG_ESP32_WIFI_SW_COEXIST_ENABLE=y
CONFIG_ESP32_WIFI_STATIC_RX_BUFFER_NUM=10
CONFIG_ESP32_WIFI_DYNAMIC_RX_BUFFER_NUM=32
CONFIG_ESP32_WIFI_STATIC_TX_BUFFER_NUM=0
CONFIG_ESP32_WIFI_DYNAMIC_TX_BUFFER_NUM=32
CONFIG_ESP32_WIFI_CSI_ENABLED=n

# MQTT Configuration
CONFIG_MQTT_TRANSPORT_SSL=n
CONFIG_MQTT_TRANSPORT_WEBSOCKET=n

# Logging Configuration
CONFIG_LOG_DEFAULT_LEVEL_INFO=y
CONFIG_LOG_MAXIMUM_LEVEL_VERBOSE=y

# Memory Configuration
CONFIG_ESP_SYSTEM_EVENT_QUEUE_SIZE=32
CONFIG_ESP_SYSTEM_EVENT_TASK_STACK_SIZE=2304

# RMT Configuration for DShot
CONFIG_RMT_ENABLE_TX=y
CONFIG_RMT_ENABLE_RX=n
```
